## arch/riscv/cpu/c9xx/Kconfig
```kconfig
# SPDX-License-Identifier: GPL-2.0+
#
# Copyright (C) 2017-2020 Alibaba Group Holding Limited

config RISCV_THEAD
	bool
	select ARCH_EARLY_INIT_R
	imply CPU
	imply CPU_RISCV
	imply RISCV_TIMER
	imply RISCV_RDTIME
	imply CMD_CPU
```

## board/sophgo/sg2042/Kconfig
```kconfig
if TARGET_SOPHGO_SG2042

config ARCH_SOPHGO
	bool
	default y

config SYS_BOARD
	default "sg2042"

config SYS_VENDOR
	default "sophgo"

config SYS_CPU
	default "generic"

config SYS_CONFIG_NAME
	default "sophgo-sg2042"

config TEXT_BASE
	default 0x80200000 if SPL
	default 0x00200000 if !RISCV_SMODE
	default 0x20200000 if RISCV_SMODE

config SPL_TEXT_BASE
	default 0x08000000

config SPL_OPENSBI_LOAD_ADDR
	default 0x80000000

config BOARD_SPECIFIC_OPTIONS
	def_bool y
	select ARCH_EARLY_INIT_R
	imply CPU
	imply CPU_RISCV
	imply RISCV_TIMER if RISCV_SMODE
	imply CMD_CPU
	imply SMP
	imply SUPPORT_OF_CONTROL
	imply OF_CONTROL
	imply OF_REAL

endif
```

## board/sunxi/Kconfig
```kconfig
menu "Board-specific options"
	depends on ARCH_SUNXI || TARGET_SUNXI

choice
	prompt "sunxi SoC Variant"

config MACH_SUN20I
	bool "sun20i (Allwinner D1)"
	depends on RISCV
	select GENERIC_RISCV
	select SPL_DM if SPL
	imply SYSRESET_SBI

endchoice

config NR_DRAM_BANKS
	default 1

choice
	prompt "SPL Image Type"
	depends on SPL
	default SPL_IMAGE_TYPE_SUNXI_EGON

config SPL_IMAGE_TYPE_SUNXI_EGON
	bool "eGON (normal)"
	help
	  Select this option to embed the SPL binary in an eGON.BT0 image,
	  which is compatible with the normal boot ROM (NBROM).

	  This is usually the correct option to choose.

config SPL_IMAGE_TYPE_SUNXI_TOC0
	bool "TOC0 (secure)"
	help
	  Select this option to embed the SPL binary in a TOC0 image,
	  which is compatible with the secure boot ROM (SBROM).

endchoice

config SPL_IMAGE_TYPE
	string
	default "sunxi_egon" if SPL_IMAGE_TYPE_SUNXI_EGON
	default "sunxi_toc0" if SPL_IMAGE_TYPE_SUNXI_TOC0

config SPL_MAX_SIZE
	hex
	default SUNXI_SRAM_SIZE

config SPL_OPENSBI_LOAD_ADDR
	default 0x40000000

config SUNXI_SRAM_ADDRESS
	hex
	default 0x20000 if MACH_SUN20I

config SUNXI_SRAM_SIZE
	hex
	default 0x28000 if MACH_SUN20I

config SYS_BOARD
	default "sunxi"

config SYS_CONFIG_NAME
	default "sun20i" if MACH_SUN20I

config SYS_CPU
	default "generic" if MACH_SUN20I

config SYS_SOC
	default "sunxi"

config SYS_TEXT_BASE
	default 0x4a000000 if MACH_SUN20I

config BOARD_SPECIFIC_OPTIONS
	def_bool y
	select CLK
	select DM_ETH if NET
	select DM_GPIO
	select DM_I2C if I2C
	select DM_SERIAL
	select DM_SPI if SPI
	select GPIO
	select MMC_SUNXI_HAS_NEW_MODE if MMC_SUNXI
	select PHY_SUN4I_USB if USB
	select PINCTRL
	select SPL_CLK if SPL_DM
	select SPL_GPIO if SPL_DM
	select SPL_OF_CONTROL if SPL_DM
	select SPL_PINCTRL if SPL_DM
	select SPL_SEPARATE_BSS if SPL
	select SUPPORT_SPL
	imply CMD_MMC
	imply CMD_USB
	imply DISTRO_DEFAULTS
	imply FIT
	imply MMC
	imply SPL
	imply SPL_SPI if SPI
	imply SPL_MMC if MMC
	imply SUNXI_GPIO
	imply SYS_I2C_MVTWSI
	imply SYS_NS16550
	imply SYSRESET
	imply USB_EHCI_GENERIC
	imply USB_EHCI_HCD
	imply USB_OHCI_GENERIC
	imply USB_OHCI_HCD
	imply WDT

endmenu
```

## configs/nezha_defconfig
```kconfig
CONFIG_RISCV=y
CONFIG_SYS_MEMTEST_START=0x40000000
CONFIG_SYS_MEMTEST_END=0x60000000
CONFIG_DEFAULT_DEVICE_TREE="sun20i-d1-nezha"
CONFIG_TARGET_SUNXI=y
CONFIG_ARCH_RV64I=y
CONFIG_RISCV_SMODE=y
# CONFIG_SPL_SMP is not set
CONFIG_SYS_LOAD_ADDR=0x4a000000
CONFIG_DEFAULT_FDT_FILE="allwinner/sun20i-d1-nezha.dtb"
CONFIG_DISPLAY_CPUINFO=y
CONFIG_DISPLAY_BOARDINFO=y
CONFIG_CMD_CONFIG=y
CONFIG_CMD_LICENSE=y
CONFIG_CMD_SBI=y
CONFIG_CMD_BOOTZ=y
# CONFIG_CMD_BOOTEFI_HELLO is not set
CONFIG_CMD_BOOTMENU=y
CONFIG_CMD_ERASEENV=y
CONFIG_CMD_ENV_CALLBACK=y
CONFIG_CMD_ENV_FLAGS=y
CONFIG_CMD_NVEDIT_EFI=y
CONFIG_CMD_NVEDIT_INFO=y
CONFIG_CMD_NVEDIT_LOAD=y
CONFIG_CMD_NVEDIT_SELECT=y
CONFIG_CMD_MEMINFO=y
CONFIG_CMD_MEMTEST=y
CONFIG_CMD_SHA1SUM=y
CONFIG_SHA1SUM_VERIFY=y
CONFIG_CMD_STRINGS=y
CONFIG_CMD_CLK=y
CONFIG_CMD_GPIO=y
CONFIG_CMD_GPT=y
CONFIG_CMD_GPT_RENAME=y
CONFIG_CMD_I2C=y
CONFIG_CMD_LSBLK=y
CONFIG_CMD_MBR=y
CONFIG_CMD_BKOPS_ENABLE=y
CONFIG_CMD_CLONE=y
CONFIG_CMD_MTD=y
CONFIG_CMD_READ=y
CONFIG_CMD_SPI=y
CONFIG_CMD_WDT=y
CONFIG_CMD_SETEXPR_FMT=y
CONFIG_CMD_DNS=y
CONFIG_CMD_EFIDEBUG=y
CONFIG_CMD_EXCEPTION=y
CONFIG_CMD_TIME=y
CONFIG_CMD_GETTIME=y
CONFIG_CMD_TIMER=y
CONFIG_CMD_UUID=y
CONFIG_CMD_REGULATOR=y
CONFIG_CMD_AES=y
CONFIG_CMD_HASH=y
CONFIG_HASH_VERIFY=y
CONFIG_CMD_EXT4_WRITE=y
CONFIG_CMD_SQUASHFS=y
CONFIG_CMD_FS_UUID=y
CONFIG_CMD_MTDPARTS=y
CONFIG_CMD_LOG=y
CONFIG_CMD_UBI=y
# CONFIG_CMD_UBIFS is not set
CONFIG_OF_PRIOR_STAGE=y
CONFIG_ENV_OVERWRITE=y
CONFIG_ENV_VARS_UBOOT_RUNTIME_CONFIG=y
CONFIG_VERSION_VARIABLE=y
CONFIG_NET_RANDOM_ETHADDR=y
CONFIG_DM_MTD=y
CONFIG_MTD_SPI_NAND=y
CONFIG_PHY_REALTEK=y
CONFIG_SUN8I_EMAC=y
CONFIG_DM_REGULATOR_FIXED=y
CONFIG_SPI=y
CONFIG_USB=y
CONFIG_DM_USB_GADGET=y
CONFIG_USB_MUSB_GADGET=y
CONFIG_USB_GADGET=y
CONFIG_USB_GADGET_DOWNLOAD=y
CONFIG_USB_FUNCTION_MASS_STORAGE=y
CONFIG_CC_OPTIMIZE_LIBS_FOR_SPEED=y
CONFIG_BZIP2=y
CONFIG_EFI_SECURE_BOOT=y
CONFIG_TEST_FDTDEC=y
```

## configs/nezha_devel_defconfig
```kconfig
CONFIG_RISCV=y
CONFIG_SYS_MEMTEST_START=0x40000000
CONFIG_SYS_MEMTEST_END=0x60000000
CONFIG_DEFAULT_DEVICE_TREE="sun20i-d1-nezha-2g"
CONFIG_IDENT_STRING="devel"
CONFIG_TARGET_SUNXI=y
CONFIG_ARCH_RV64I=y
CONFIG_RISCV_SMODE=y
# CONFIG_SPL_SMP is not set
CONFIG_SHOW_REGS=y
CONFIG_LOCALVERSION="-Nezhe-D1"
CONFIG_SYS_BOOT_GET_CMDLINE=y
CONFIG_SYS_BOOT_GET_KBD=y
CONFIG_SYS_LOAD_ADDR=0x4a000000
CONFIG_ANDROID_BOOT_IMAGE=y
CONFIG_CHROMEOS=y
CONFIG_CHROMEOS_VBOOT=y
CONFIG_SD_BOOT=y
CONFIG_AUTOBOOT_KEYED=y
CONFIG_AUTOBOOT_DELAY_STR="f"
CONFIG_AUTOBOOT_STOP_STR="v"
CONFIG_AUTOBOOT_KEYED_CTRLC=y
CONFIG_USE_PREBOOT=y
CONFIG_PREBOOT="run mmcbootenv"
CONFIG_DEFAULT_FDT_FILE="allwinner/sun20i-d1-nezha-2g.dtb"
CONFIG_DISPLAY_CPUINFO=y
CONFIG_DISPLAY_BOARDINFO=y
CONFIG_SYS_PROMPT="[Nezha]# "
CONFIG_CMD_CONFIG=y
CONFIG_CMD_LICENSE=y
CONFIG_CMD_SBI=y
CONFIG_CMD_BOOTZ=y
# CONFIG_CMD_BOOTEFI_HELLO is not set
CONFIG_CMD_BOOTEFI_SELFTEST=y
CONFIG_CMD_BOOTMENU=y
CONFIG_CMD_ADTIMG=y
CONFIG_CMD_ABOOTIMG=y
CONFIG_CMD_GREPENV=y
CONFIG_CMD_ERASEENV=y
CONFIG_CMD_ENV_CALLBACK=y
CONFIG_CMD_ENV_FLAGS=y
CONFIG_CMD_NVEDIT_EFI=y
CONFIG_CMD_NVEDIT_INFO=y
CONFIG_CMD_NVEDIT_LOAD=y
CONFIG_CMD_NVEDIT_SELECT=y
CONFIG_CRC32_VERIFY=y
CONFIG_LOOPW=y
CONFIG_CMD_MD5SUM=y
CONFIG_MD5SUM_VERIFY=y
CONFIG_CMD_MEMINFO=y
CONFIG_CMD_MEM_SEARCH=y
CONFIG_CMD_MX_CYCLIC=y
CONFIG_CMD_MEMTEST=y
CONFIG_SYS_ALT_MEMTEST=y
CONFIG_CMD_SHA1SUM=y
CONFIG_SHA1SUM_VERIFY=y
CONFIG_CMD_STRINGS=y
CONFIG_CMD_BCB=y
CONFIG_CMD_BIND=y
CONFIG_CMD_CLK=y
CONFIG_CMD_GPIO=y
CONFIG_CMD_GPT=y
CONFIG_CMD_GPT_RENAME=y
CONFIG_CMD_I2C=y
CONFIG_CMD_LSBLK=y
CONFIG_CMD_MBR=y
CONFIG_CMD_BKOPS_ENABLE=y
CONFIG_CMD_MMC_SWRITE=y
CONFIG_CMD_CLONE=y
CONFIG_CMD_MTD=y
CONFIG_CMD_READ=y
CONFIG_CMD_SF_TEST=y
CONFIG_CMD_SPI=y
CONFIG_CMD_WDT=y
CONFIG_CMD_SETEXPR_FMT=y
CONFIG_CMD_DNS=y
CONFIG_CMD_EFIDEBUG=y
CONFIG_CMD_EXCEPTION=y
CONFIG_CMD_TIME=y
CONFIG_CMD_GETTIME=y
CONFIG_CMD_TIMER=y
CONFIG_CMD_QFW=y
CONFIG_CMD_UUID=y
CONFIG_CMD_REGULATOR=y
CONFIG_CMD_AES=y
CONFIG_CMD_HASH=y
CONFIG_HASH_VERIFY=y
CONFIG_CMD_CBFS=y
CONFIG_CMD_CRAMFS=y
CONFIG_CMD_EXT4_WRITE=y
CONFIG_CMD_SQUASHFS=y
CONFIG_CMD_FS_UUID=y
CONFIG_CMD_MTDPARTS=y
CONFIG_CMD_MTDPARTS_SPREAD=y
CONFIG_CMD_MTDPARTS_SHOW_NET_SIZES=y
CONFIG_CMD_ZFS=y
CONFIG_CMD_LOG=y
CONFIG_CMD_UBI=y
CONFIG_CMD_UBI_RENAME=y
# CONFIG_CMD_UBIFS is not set
CONFIG_ENV_OVERWRITE=y
CONFIG_ENV_VARS_UBOOT_RUNTIME_CONFIG=y
CONFIG_VERSION_VARIABLE=y
CONFIG_NET_RANDOM_ETHADDR=y
CONFIG_DM_MTD=y
CONFIG_MTD_SPI_NAND=y
CONFIG_PHY_REALTEK=y
CONFIG_SUN8I_EMAC=y
CONFIG_DM_REGULATOR_FIXED=y
CONFIG_SPI=y
CONFIG_USB=y
CONFIG_DM_USB_GADGET=y
CONFIG_USB_MUSB_GADGET=y
CONFIG_USB_GADGET=y
CONFIG_USB_GADGET_DOWNLOAD=y
CONFIG_USB_FUNCTION_MASS_STORAGE=y
CONFIG_FS_CBFS=y
CONFIG_SPL_FS_CBFS=y
CONFIG_FS_CRAMFS=y
# CONFIG_BINMAN_FDT is not set
CONFIG_CC_OPTIMIZE_LIBS_FOR_SPEED=y
# CONFIG_ASYMMETRIC_KEY_TYPE is not set
CONFIG_SHA384=y
CONFIG_LZO=y
CONFIG_BZIP2=y
# CONFIG_HEXDUMP is not set
CONFIG_TEST_FDTDEC=y
CONFIG_UNIT_TEST=y
```

## configs/qemu-riscv64_smode_defconfig
```kconfig
CONFIG_RISCV=y
CONFIG_NR_DRAM_BANKS=1
CONFIG_TARGET_QEMU_VIRT=y
CONFIG_ARCH_RV64I=y
CONFIG_RISCV_SMODE=y
CONFIG_DISTRO_DEFAULTS=y
CONFIG_FIT=y
CONFIG_DISPLAY_CPUINFO=y
CONFIG_DISPLAY_BOARDINFO=y
# CONFIG_CMD_MII is not set
CONFIG_OF_PRIOR_STAGE=y
CONFIG_USE_PREBOOT=y
CONFIG_PREBOOT="setenv fdt_addr ${fdtcontroladdr}; fdt addr ${fdtcontroladdr};"
```

## configs/sophgo_sg2042_defconfig
```kconfig
CONFIG_RISCV=y
CONFIG_SYS_MALLOC_LEN=0x800000
CONFIG_SYS_MALLOC_F_LEN=0x3000
CONFIG_NR_DRAM_BANKS=1
CONFIG_HAS_CUSTOM_SYS_INIT_SP_ADDR=y
CONFIG_CUSTOM_SYS_INIT_SP_ADDR=0x80200000
CONFIG_DEFAULT_DEVICE_TREE="sophgo-sg2042-a00"
CONFIG_SYS_PROMPT="SOPHGO=> "
CONFIG_OF_LIBFDT_OVERLAY=y
CONFIG_SYS_LOAD_ADDR=0x80200000
CONFIG_TARGET_SOPHGO_SG2042=y
CONFIG_ARCH_RV64I=y
CONFIG_RISCV_SMODE=y
CONFIG_SYS_BOOT_GET_CMDLINE=y
CONFIG_SYS_BOOT_GET_KBD=y
CONFIG_ANDROID_BOOT_IMAGE=y
CONFIG_FIT=y
CONFIG_FIT_CIPHER=y
CONFIG_FIT_VERBOSE=y
CONFIG_BOOTSTD_FULL=y
CONFIG_BOOTSTD_DEFAULTS=y
# CONFIG_BOOTMETH_SCRIPT is not set
CONFIG_CHROMEOS=y
CONFIG_CHROMEOS_VBOOT=y
CONFIG_DISTRO_DEFAULTS=y
CONFIG_BOOTARGS_SUBST=y
CONFIG_BOOTCOMMAND="ext4load mmc 0:2 0xa0000000 /uEnv_sophgo_sg2042.txt; env import -t 0xa0000000 ${filesize};boot"
CONFIG_USE_PREBOOT=y
CONFIG_PREBOOT="setenv fdt_addr ${fdtcontroladdr};fdt addr ${fdtcontroladdr};"
CONFIG_DEFAULT_FDT_FILE="sophgo/sophgo-sg2042-a00.dtb"
CONFIG_DISPLAY_CPUINFO=y
CONFIG_DISPLAY_BOARDINFO=y
CONFIG_DISPLAY_BOARDINFO_LATE=y
CONFIG_CMDLINE_PS_SUPPORT=y
CONFIG_SYS_CBSIZE=256
CONFIG_SYS_PBSIZE=276
CONFIG_CMD_CONFIG=y
CONFIG_CMD_LICENSE=y
CONFIG_CMD_SBI=y
CONFIG_CMD_BOOTZ=y
CONFIG_BOOTM_OPENRTOS=y
CONFIG_SYS_BOOTM_LEN=0x4000000
CONFIG_CMD_BOOTEFI_SELFTEST=y
CONFIG_CMD_BOOTMENU=y
CONFIG_CMD_ADTIMG=y
CONFIG_CMD_ABOOTIMG=y
CONFIG_CMD_ASKENV=y
CONFIG_CMD_GREPENV=y
CONFIG_CMD_ERASEENV=y
CONFIG_CMD_NVEDIT_EFI=y
CONFIG_CMD_NVEDIT_INDIRECT=y
CONFIG_CMD_NVEDIT_INFO=y
CONFIG_CMD_NVEDIT_LOAD=y
CONFIG_CMD_NVEDIT_SELECT=y
CONFIG_CMD_BINOP=y
CONFIG_CRC32_VERIFY=y
CONFIG_LOOPW=y
CONFIG_CMD_MD5SUM=y
CONFIG_MD5SUM_VERIFY=y
CONFIG_CMD_MEMINFO=y
CONFIG_CMD_MEM_SEARCH=y
CONFIG_CMD_MX_CYCLIC=y
CONFIG_CMD_MEMTEST=y
CONFIG_CMD_STRINGS=y
CONFIG_CMD_ZIP=y
CONFIG_CMD_BCB=y
CONFIG_CMD_BIND=y
CONFIG_CMD_CLK=y
CONFIG_CMD_DFU=y
CONFIG_CMD_GPT=y
CONFIG_CMD_GPT_RENAME=y
CONFIG_CMD_LOADM=y
CONFIG_LOADS_ECHO=y
CONFIG_CMD_SAVES=y
CONFIG_SYS_LOADS_BAUD_CHANGE=y
CONFIG_CMD_LSBLK=y
CONFIG_CMD_MBR=y
CONFIG_CMD_MMC=y
CONFIG_CMD_BKOPS_ENABLE=y
CONFIG_CMD_MMC_SWRITE=y
CONFIG_CMD_CLONE=y
CONFIG_CMD_MTD=y
CONFIG_CMD_PCI=y
CONFIG_CMD_READ=y
CONFIG_CMD_SDRAM=y
CONFIG_CMD_WRITE=y
CONFIG_CMD_CAT=y
CONFIG_CMD_SETEXPR_FMT=y
CONFIG_BOOTP_MAY_FAIL=y
CONFIG_BOOTP_BOOTFILESIZE=y
CONFIG_BOOTP_DNS2=y
CONFIG_BOOTP_PREFER_SERVERIP=y
CONFIG_BOOTP_NISDOMAIN=y
CONFIG_BOOTP_NTPSERVER=y
CONFIG_BOOTP_TIMEOFFSET=y
CONFIG_CMD_PCAP=y
CONFIG_CMD_TFTPPUT=y
CONFIG_CMD_TFTPSRV=y
CONFIG_CMD_RARP=y
CONFIG_CMD_WGET=y
CONFIG_CMD_CDP=y
CONFIG_CMD_SNTP=y
CONFIG_CMD_DNS=y
CONFIG_CMD_LINK_LOCAL=y
CONFIG_CMD_WOL=y
CONFIG_CMD_EFIDEBUG=y
CONFIG_CMD_EXCEPTION=y
CONFIG_CMD_INI=y
CONFIG_CMD_TIME=y
CONFIG_CMD_GETTIME=y
CONFIG_CMD_PAUSE=y
CONFIG_CMD_TIMER=y
CONFIG_CMD_UUID=y
CONFIG_CMD_AES=y
CONFIG_CMD_HASH=y
CONFIG_HASH_VERIFY=y
CONFIG_CMD_BTRFS=y
CONFIG_CMD_EROFS=y
CONFIG_CMD_EXT4_WRITE=y
CONFIG_CMD_SQUASHFS=y
CONFIG_CMD_FS_UUID=y
CONFIG_CMD_REISER=y
CONFIG_CMD_ZFS=y
CONFIG_CMD_DIAG=y
CONFIG_CMD_EVENT=y
CONFIG_CMD_LOG=y
CONFIG_MMC_SPEED_MODE_SET=y
CONFIG_PARTITION_TYPE_GUID=y
CONFIG_ENV_IS_IN_FAT=y
CONFIG_ENV_FAT_DEVICE_AND_PART="0:1"
CONFIG_SYS_RELOC_GD_ENV_ADDR=y
CONFIG_USE_HOSTNAME=y
CONFIG_HOSTNAME="sophgo.uboot"
CONFIG_VERSION_VARIABLE=y
CONFIG_BOOTP_SEND_HOSTNAME=y
CONFIG_NET_RANDOM_ETHADDR=y
CONFIG_NETCONSOLE=y
CONFIG_SYS_FAULT_ECHO_LINK_DOWN=y
CONFIG_TFTP_PORT=y
CONFIG_TFTP_TSIZE=y
CONFIG_SERVERIP_FROM_PROXYDHCP=y
CONFIG_KEEP_SERVERADDR=y
CONFIG_BOOTP_SERVERIP=y
CONFIG_IPV6=y
CONFIG_MMC=y
CONFIG_MMC_SDHCI=y
CONFIG_MMC_SDHCI_BITMAIN=y
CONFIG_MTD_UBI=y
CONFIG_SYS_NS16550=y
CONFIG_FS_CBFS=y
CONFIG_UBIFS_SILENCE_MSG=y
CONFIG_FS_CRAMFS=y
CONFIG_SHA512=y
CONFIG_BZIP2=y
CONFIG_LIB_RATIONAL=y
CONFIG_SMBIOS_PARSER=y
```
